## versions/YDP210H003-V1/examples/esp32p4-idf6_st7701-mipi_lvgl9/sdkconfig.defaults.esp32p4
```kconfig
CONFIG_BOOTLOADER_LOG_LEVEL_WARN=y
CONFIG_ESPTOOLPY_FLASHMODE_QIO=y
CONFIG_ESPTOOLPY_FLASHFREQ_80M=y
CONFIG_ESPTOOLPY_FLASHSIZE_16MB=y

CONFIG_SPIRAM=y
CONFIG_SPIRAM_SPEED_250M=y
CONFIG_SPIRAM_XIP_FROM_PSRAM=y

# 使用partitions.csv
CONFIG_PARTITION_TABLE_CUSTOM=y
```
